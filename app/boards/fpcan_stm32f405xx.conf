## boards/rhs/fpcan/Kconfig.fpcan
```kconfig
# Copyright (c) 2025 Sergey Golovin <golovinengineer@icloud.com>
# SPDX-License-Identifier: Apache-2.0

config BOARD_FPCAN
	select SOC_STM32F405XX
```

## boards/rhs/fpcan/board.yml
```yaml
board:
  name: fpcan
  full_name: FPCAN
  vendor: rhs
  socs:
    - name: stm32f405xx
```

## boards/rhs/fpcan/fpcan_defconfig
```kconfig
# SPDX-License-Identifier: Apache-2.0

# Enable MPU
CONFIG_ARM_MPU=y

# Enable HW stack protection
CONFIG_HW_STACK_PROTECTION=y

# console
CONFIG_CONSOLE=y

# enable GPIO
CONFIG_GPIO=y
```
